## package/ifupdown-ng/Config.in
```kconfig
config BR2_PACKAGE_IFUPDOWN_NG
	bool "ifupdown-ng"
	depends on BR2_USE_MMU # fork()
	select BR2_PACKAGE_IPROUTE2 if !BR2_PACKAGE_BUSYBOX
	help
	  ifupdown-ng is a network interface manager compatible with the
	  /etc/network/interfaces format, with a modern executor and
	  dependency model that natively handles bridges, VLANs, bonds
	  and more.  A drop-in replacement for the BusyBox and Debian
	  ifupdown tools.

	  https://github.com/ifupdown-ng/ifupdown-ng
```

## package/merecat/Config.in
```kconfig
config BR2_PACKAGE_MERECAT
	bool "merecat"
	select BR2_PACKAGE_LIBCONFUSE
	select BR2_PACKAGE_OPENSSL
	select BR2_PACKAGE_ZLIB
	help
	  Merecat is a small HTTP/HTTPS server derived from thttpd, with
	  CGI, TLS, virtual hosts and a reverse proxy.  In myLinux it is
	  the system web server: it serves the local web UI and fronts
	  clixon's native RESTCONF API.

	  https://github.com/troglobit/merecat
```

## package/webif/Config.in
```kconfig
config BR2_PACKAGE_WEBIF
	bool "webif - web interface"
	depends on BR2_PACKAGE_MECH
	select BR2_PACKAGE_MERECAT
	help
	  The myLinux web interface: status, system and interface
	  settings, and maintenance.  A static page that talks RESTCONF
	  to clixon from the browser, so it has no server side of its
	  own.  Merecat serves it and fronts the RESTCONF API.

	  Log in as any local user with administrator rights.

comment "webif needs mech"
	depends on !BR2_PACKAGE_MECH
```
