## Config.in
```kconfig
menu "Emulator options"

config QEMU_ARCH
	string
	default "arm"     if BR2_arm926t
	default "aarch64" if BR2_aarch64
	default "x86_64"  if BR2_x86_64
	default BR2_ARCH

config QEMU_MACH
	string "Machine"
	default "q35,accel=kvm -cpu host -enable-kvm" if BR2_x86_64
	default "virt -cpu cortex-a53"                if BR2_aarch64
	default "virt,highmem=off"                    if BR2_cortex_a9 || BR2_cortex_a5
	default "versatilepb -dtb versatile-pb.dtb"   if BR2_arm926t
	default ""
	help
	 The arch specific machine (CPU board) to emulate and any specific args.

config QEMU_SMP
	string "SMP number of cores"
	help
	 Number of CPU cores for SMP operation.

config QEMU_MEM
	string "RAM size"
	default "256M"
	help
	 Amount of RAM for board.

config QEMU_EXTRA
	string "Extra args"
	default " -watchdog i6300esb -rtc clock=host"

choice
	bool "Network mode"
	default QEMU_NET_BRIDGE
	help
	 Select Qemu network mode.

config QEMU_NET_BRIDGE
	bool "bridge"
	help
	 Bridged with, e.g., host virbr0

config QEMU_NET_TAP
	bool "tap"
	help
	   Creates qtapN interface(s), see QEMU_N_NICS

config QEMU_NET_USER
	bool "user"
	help
	 Qemu user networking -- non-root option

endchoice

config QEMU_NET
	string
	default "bridge" if QEMU_NET_BRIDGE
	default "tap"    if QEMU_NET_TAP
	default "user"   if QEMU_NET_USER

if ! QEMU_NET_USER

config QEMU_N_NICS
	int "Number of Ethernet interfaces"
	default 1
	help
	 Number of Ethernet interfaces to emulate.

endif

config QEMU_NIC
	string "Ethernet NIC model"
	default "virtio-net-pci"
	help
	 Ethernet NIC to emulate.

config QEMU_SCSI
	string "Disk controller"
	default "virtio-scsi-pci"
	help
	 SCSI disk interface to emulate.

config QEMU_GDB
	bool "Enable GDB console"
	default n
	help
	  Enable GDB socket with hvc1 console for gdbserver.

config QEMU_KERNEL
	string
	default "bzImage" if BR2_LINUX_KERNEL_BZIMAGE
	default "zImage"  if BR2_LINUX_KERNEL_ZIMAGE
	default "Image"   if BR2_LINUX_KERNEL_IMAGE

config QEMU_DISK
	string
	default "rootfs.ext2" if BR2_TARGET_ROOTFS_EXT2
	default ""

config QEMU_INITRD
	string
	default "rootfs.squashfs" if BR2_TARGET_ROOTFS_SQUASHFS
	default ""

endmenu

menu Packages

source "$BR2_EXTERNAL_MYLINUX_PATH/package/Config.in"

endmenu
```

## Kconfig
```kconfig
#
# For a description of the syntax of this configuration file,
# see doc/kconfig/kconfig-language.txt.
#
mainmenu "TroglOS Virtual Devboard Configuration"

# Magic marker used by build system
config DOT_CONFIG
	bool
	default y

# This is where all Qemu and toolchain specific settings go
source "arch/Kconfig"

# Kernel specifics: version, rc, cmdline
source "kernel/Kconfig"

# Target system libraries, or dependencies from packages
source "lib/Kconfig"

# Target system daemons, tools
source "packages/Kconfig"

# User defined programs, tools
source "user/Kconfig"
```

## arch/Kconfig
```kconfig
menu "Target"

choice
	prompt "Select Target Platform"
	default ARM

config ARM
	bool "ARM 32-bit"

config ARM64
	bool "ARM 64-bit"

config PPC
	bool "PowerPC 32-bit"

config X86
        bool "AMD/Intel x86"

endchoice

config ARCH
	string
	default "arm" if ARM
	default "arm64" if ARM64
	default "ppc" if PPC
	default "x86" if X86

source "arch/arm/Kconfig"
source "arch/arm64/Kconfig"
source "arch/ppc/Kconfig"
source "arch/x86/Kconfig"

comment "Toolchain and Build Specific Settings"

config TOOLCHAIN_PREFIX
config TOOLCHAIN_PREFIX
	string "Crosstool-NG toolchain prefix"
	help
	  myrootfs is built using Crosstool-NG which provides a lot of
	  useful tools to, not only cross-compile, but also to create
	  the resulting root file system.

	  The default setting is selected based on the target arch.
	  using GCC and GLIBC, e.g. "arch-unknown-linux-gnu-":

	  Arm      32-bit     arm-unknown-linux-gnueabi-
	  Arm      64-bit     aarch64-unknown-linux-gnu-
	  PowerPC  32-bit     powerpc-unknown-linux-gnu-
	  x86      32/64-bit  x86_64-unknown-linux-gnu-
	default "arm-unknown-linux-gnueabi-" if ARM
	default "aarch64-unknown-linux-gnu-" if ARM64
	default "powerpc-unknown-linux-gnu-" if PPC
	default "x86_64-unknown-linux-gnu-" if X86

endmenu
```

## arch/arm/Kconfig
```kconfig
choice
	prompt "Select Target Machine"
	default VERSATILE
     	depends on ARM

config VERSATILE
	bool "ARM Versatile-PB"

config RASPBERRY
	bool "Raspberry Pi 2/3"

config SDCARD
	string "SD card device for Raspberry Pi"
	default "/dev/mmcblk0"
	help
	   The device to use for `make sdcard`
	depends on RASPBERRY
endchoice

config MACH
	string
	default "versatile" if VERSATILE
	default "raspberry" if RASPBERRY
     	depends on ARM
```

## arch/arm64/Kconfig
```kconfig
choice
	prompt "Select Target Machine"
	default GENERIC
     	depends on ARM64

config GENERIC
	bool "Generic ARM64 target, with Cortex A57 for qemu"

config MCBIN
	bool "Marvell MACCHIATObin, ARMADA 8040 SoC"

config SDCARD
	string "SD card device for Marvell MACCHIATObin"
	default "/dev/mmcblk0"
	help
	   The device to use for `make sdcard`
	depends on MCBIN
endchoice

config MACH
	string
	default "generic" if GENERIC
	default "mcbin" if MCBIN
     	depends on ARM64
```

## arch/arm64/mcbin/image.its
```
/*
 * U-Boot uImage source file with multiple kernels, ramdisks and FDT blobs
 */

/dts-v1/;

/ {
	description = "Various kernels, ramdisks and FDT blobs";
	#address-cells = <1>;

	images {
		kernel-1 {
			description = "Linux 4.15.4";
			data = /incbin/("./Image");
			type = "kernel";
			arch = "arm64";
			os = "linux";
			compression = "gzip";
			load = <00000000>;
			entry = <00000000>;
			hash-1 {
				algo = "md5";
			};
			hash-2 {
				algo = "sha1";
			};
		};

		ramdisk-1 {
			description = "Base system";
			data = /incbin/("./initramfs.img");
			type = "ramdisk";
			arch = "arm64";
			os = "linux";
			compression = "none";
			load = <00000000>;
			entry = <00000000>;
			hash-1 {
				algo = "sha1";
			};
		};

		fdt-1 {
			description = "MacchiatoBin Device Tree";
			data = /incbin/("./marvell/armada-8040-mcbin.dtb");
			type = "flat_dt";
			arch = "arm64";
			compression = "none";
			hash-1 {
				algo = "crc32";
			};
		};

	};

	configurations {
		default = "config-1";

		config-1 {
			description = "myLinux on Marvell MacchiatoBin";
			kernel = "kernel-1";
			ramdisk = "ramdisk-1";
			fdt = "fdt-1";
		};
	};
};
```

## arch/ppc/Kconfig
```kconfig
choice
	prompt "Select Target Machine"
	default PPCE500
     	depends on PPC

config PPCE500
	bool "PowerPC e500"

config PPCE500MC
	bool "PowerPC e500mc"

endchoice

config MACH
	string
	default "ppce500"   if PPCE500
	default "ppce500mc" if PPCE500MC
     	depends on PPC
```

## arch/x86/Kconfig
```kconfig
choice
	prompt "Select Target Machine"
	default X86_64
     	depends on X86

config X86_64
	bool "AMD/Intel x86 64-bit"

endchoice

config MACH
	string
	default "x86_64" if X86_64
     	depends on X86
```

## board/clearfog/linux_defconfig
```kconfig
CONFIG_SYSVIPC=y
CONFIG_POSIX_MQUEUE=y
CONFIG_WATCH_QUEUE=y
CONFIG_HIGH_RES_TIMERS=y
CONFIG_IKCONFIG=y
CONFIG_IKCONFIG_PROC=y
CONFIG_LOG_BUF_SHIFT=16
CONFIG_CGROUPS=y
CONFIG_MEMCG=y
CONFIG_BLK_CGROUP=y
CONFIG_CGROUP_SCHED=y
CONFIG_RT_GROUP_SCHED=y
CONFIG_CGROUP_PIDS=y
CONFIG_CGROUP_RDMA=y
CONFIG_CGROUP_FREEZER=y
CONFIG_CPUSETS=y
CONFIG_CGROUP_DEVICE=y
CONFIG_CGROUP_CPUACCT=y
CONFIG_CGROUP_PERF=y
CONFIG_CGROUP_MISC=y
CONFIG_CGROUP_DEBUG=y
CONFIG_NAMESPACES=y
CONFIG_BLK_DEV_INITRD=y
CONFIG_EXPERT=y
CONFIG_PERF_EVENTS=y
CONFIG_SLAB=y
CONFIG_ARCH_MVEBU=y
CONFIG_MACH_ARMADA_370=y
CONFIG_MACH_ARMADA_375=y
CONFIG_MACH_ARMADA_38X=y
CONFIG_MACH_ARMADA_39X=y
CONFIG_MACH_ARMADA_XP=y
CONFIG_MACH_DOVE=y
CONFIG_SMP=y
CONFIG_HIGHMEM=y
CONFIG_ARM_APPENDED_DTB=y
CONFIG_ARM_ATAG_DTB_COMPAT=y
CONFIG_CPU_FREQ=y
CONFIG_CPUFREQ_DT=y
CONFIG_CPU_IDLE=y
CONFIG_ARM_MVEBU_V7_CPUIDLE=y
CONFIG_VFP=y
CONFIG_NEON=y
# CONFIG_GCC_PLUGINS is not set
CONFIG_MODULES=y
CONFIG_MODULE_UNLOAD=y
CONFIG_MODPROBE_PATH=""
# CONFIG_COMPACTION is not set
CONFIG_NET=y
CONFIG_PACKET=y
CONFIG_UNIX=y
CONFIG_INET=y
CONFIG_IP_MULTICAST=y
CONFIG_IP_ADVANCED_ROUTER=y
CONFIG_IP_MULTIPLE_TABLES=y
CONFIG_IP_ROUTE_MULTIPATH=y
CONFIG_IP_PNP=y
CONFIG_IP_PNP_DHCP=y
CONFIG_IP_PNP_BOOTP=y
CONFIG_NET_IPIP=y
CONFIG_NET_IPGRE_DEMUX=y
CONFIG_NET_IPGRE=y
CONFIG_IP_MROUTE=y
CONFIG_IP_MROUTE_MULTIPLE_TABLES=y
CONFIG_IP_PIMSM_V1=y
CONFIG_IP_PIMSM_V2=y
CONFIG_TCP_CONG_ADVANCED=y
CONFIG_TCP_CONG_VEGAS=m
CONFIG_TCP_CONG_SCALABLE=m
CONFIG_TCP_CONG_LP=m
CONFIG_TCP_CONG_VENO=m
CONFIG_TCP_CONG_ILLINOIS=m
CONFIG_NETFILTER=y
CONFIG_NF_CONNTRACK=y
CONFIG_NF_LOG_SYSLOG=y
CONFIG_NF_TABLES=y
CONFIG_NF_TABLES_INET=y
CONFIG_NFT_CT=y
CONFIG_NFT_MASQ=y
CONFIG_NFT_NAT=y
CONFIG_NETFILTER_XT_TARGET_DSCP=y
CONFIG_NETFILTER_XT_TARGET_MARK=y
CONFIG_NETFILTER_XT_NAT=y
CONFIG_NETFILTER_XT_TARGET_NETMAP=y
CONFIG_NETFILTER_XT_TARGET_NFLOG=y
CONFIG_NETFILTER_XT_TARGET_NFQUEUE=y
CONFIG_NETFILTER_XT_TARGET_MASQUERADE=y
CONFIG_NETFILTER_XT_TARGET_TCPMSS=y
CONFIG_NETFILTER_XT_MATCH_CONNMARK=y
CONFIG_NETFILTER_XT_MATCH_CONNTRACK=y
CONFIG_NETFILTER_XT_MATCH_DSCP=y
CONFIG_NETFILTER_XT_MATCH_ECN=y
CONFIG_NETFILTER_XT_MATCH_IPRANGE=y
CONFIG_NETFILTER_XT_MATCH_MARK=y
CONFIG_NETFILTER_XT_MATCH_MULTIPORT=y
CONFIG_NETFILTER_XT_MATCH_RECENT=y
CONFIG_NETFILTER_XT_MATCH_TCPMSS=y
CONFIG_NETFILTER_XT_MATCH_U32=y
CONFIG_IP_NF_IPTABLES=y
CONFIG_IP_NF_MATCH_RPFILTER=y
CONFIG_IP_NF_MATCH_TTL=y
CONFIG_IP_NF_FILTER=y
CONFIG_IP_NF_TARGET_REJECT=y
CONFIG_IP_NF_MANGLE=y
CONFIG_IP_NF_TARGET_ECN=y
CONFIG_IP_NF_TARGET_TTL=y
CONFIG_BRIDGE=y
CONFIG_BRIDGE_VLAN_FILTERING=y
CONFIG_BRIDGE_MRP=y
CONFIG_BRIDGE_CFM=y
CONFIG_NET_DSA=y
CONFIG_VLAN_8021Q=y
CONFIG_VLAN_8021Q_GVRP=y
CONFIG_VLAN_8021Q_MVRP=y
CONFIG_BT=y
CONFIG_BT_MRVL=y
CONFIG_BT_MRVL_SDIO=y
CONFIG_CFG80211=y
CONFIG_CFG80211_WEXT=y
CONFIG_MAC80211=y
CONFIG_RFKILL=y
CONFIG_PCI=y
CONFIG_PCI_MVEBU=y
CONFIG_UEVENT_HELPER=y
CONFIG_UEVENT_HELPER_PATH="/sbin/mdev"
CONFIG_DEVTMPFS=y
CONFIG_DEVTMPFS_MOUNT=y
CONFIG_FW_LOADER_USER_HELPER=y
CONFIG_MTD=y
CONFIG_MTD_CMDLINE_PARTS=y
CONFIG_MTD_BLOCK=y
CONFIG_MTD_CFI=y
CONFIG_MTD_CFI_INTELEXT=y
CONFIG_MTD_CFI_AMDSTD=y
CONFIG_MTD_CFI_STAA=y
CONFIG_MTD_RAW_NAND=y
CONFIG_MTD_NAND_MARVELL=y
CONFIG_MTD_SPI_NOR=y
CONFIG_MTD_UBI=y
CONFIG_BLK_DEV_LOOP=y
CONFIG_EEPROM_AT24=y
CONFIG_EEPROM_93CX6=y
CONFIG_SCSI=y
CONFIG_BLK_DEV_SD=y
CONFIG_NETDEVICES=y
CONFIG_NET_DSA_MV88E6XXX=y
CONFIG_NET_DSA_MV88E6XXX_PTP=y
CONFIG_MV643XX_ETH=y
CONFIG_MVNETA_BM_ENABLE=y
CONFIG_MVNETA=y
CONFIG_MVPP2=y
CONFIG_SFP=y
CONFIG_MARVELL_PHY=y
CONFIG_ADM8211=m
CONFIG_ATH9K=m
CONFIG_ATH9K_AHB=y
CONFIG_ATH9K_DYNACK=y
CONFIG_ATH9K_WOW=y
CONFIG_ATH9K_CHANNEL_CONTEXT=y
CONFIG_ATH9K_PCI_NO_EEPROM=m
CONFIG_ATH9K_HTC=m
CONFIG_B43=m
CONFIG_B43_SDIO=y
CONFIG_B43LEGACY=m
CONFIG_BRCMFMAC=m
# CONFIG_WLAN_VENDOR_CISCO is not set
# CONFIG_WLAN_VENDOR_INTEL is not set
CONFIG_MWIFIEX=m
CONFIG_MWIFIEX_SDIO=m
CONFIG_MWIFIEX_PCIE=m
CONFIG_MWIFIEX_USB=m
CONFIG_MWL8K=m
CONFIG_MT7601U=m
CONFIG_MT76x0U=m
CONFIG_MT76x0E=m
CONFIG_MT76x2E=m
CONFIG_MT76x2U=m
CONFIG_MT7603E=m
CONFIG_MT7615E=m
CONFIG_MT7663U=m
CONFIG_MT7663S=m
CONFIG_MT7915E=m
CONFIG_MT7921E=m
CONFIG_RT2X00=m
CONFIG_RT2400PCI=m
CONFIG_RT2500PCI=m
CONFIG_RT61PCI=m
CONFIG_RT2800PCI=m
CONFIG_RT2500USB=m
CONFIG_RT73USB=m
CONFIG_RT2800USB=m
CONFIG_RT2800USB_RT3573=y
CONFIG_RT2800USB_RT53XX=y
CONFIG_RT2800USB_RT55XX=y
CONFIG_RT2800USB_UNKNOWN=y
CONFIG_RTL8180=m
CONFIG_RTL8187=m
CONFIG_RTL8192CE=m
CONFIG_RTL8192SE=m
CONFIG_RTL8192DE=m
CONFIG_RTL8723AE=m
CONFIG_RTL8723BE=m
CONFIG_RTL8188EE=m
CONFIG_RTL8192EE=m
CONFIG_RTL8821AE=m
CONFIG_RTL8192CU=m
CONFIG_RTL8XXXU=m
CONFIG_RTL8XXXU_UNTESTED=y
CONFIG_RTW88=y
CONFIG_RTW88_8822BE=m
CONFIG_RTW88_8822CE=m
CONFIG_RTW88_8723DE=m
CONFIG_RTW88_8821CE=m
CONFIG_USB_ZD1201=y
CONFIG_USB_NET_RNDIS_WLAN=y
CONFIG_VIRT_WIFI=y
# CONFIG_INPUT is not set
# CONFIG_SERIO is not set
# CONFIG_VT is not set
CONFIG_SERIAL_8250=y
CONFIG_SERIAL_8250_CONSOLE=y
CONFIG_SERIAL_8250_DW=y
CONFIG_SERIAL_OF_PLATFORM=y
CONFIG_I2C=y
CONFIG_I2C_CHARDEV=y
CONFIG_I2C_MV64XXX=y
CONFIG_SPI=y
CONFIG_SPI_ORION=y
CONFIG_GPIO_SYSFS=y
CONFIG_GPIO_PCA953X=y
CONFIG_POWER_RESET=y
CONFIG_POWER_RESET_GPIO=y
CONFIG_POWER_SUPPLY=y
CONFIG_SENSORS_GPIO_FAN=y
CONFIG_SENSORS_MCP3021=y
CONFIG_THERMAL=y
CONFIG_ARMADA_THERMAL=y
CONFIG_WATCHDOG=y
CONFIG_WATCHDOG_PRETIMEOUT_GOV=y
CONFIG_SOFT_WATCHDOG=y
CONFIG_ARMADA_37XX_WATCHDOG=y
CONFIG_ORION_WATCHDOG=y
CONFIG_REGULATOR=y
CONFIG_REGULATOR_FIXED_VOLTAGE=y
CONFIG_USB_ULPI_BUS=y
CONFIG_USB=y
CONFIG_USB_ANNOUNCE_NEW_DEVICES=y
CONFIG_USB_DYNAMIC_MINORS=y
CONFIG_USB_XHCI_HCD=y
CONFIG_USB_XHCI_MVEBU=y
CONFIG_USB_EHCI_HCD=y
CONFIG_USB_EHCI_ROOT_HUB_TT=y
CONFIG_USB_WDM=y
CONFIG_USB_STORAGE=y
CONFIG_USB_SERIAL=y
CONFIG_USB_SERIAL_GENERIC=y
CONFIG_USB_SERIAL_CP210X=y
CONFIG_USB_SERIAL_FTDI_SIO=y
CONFIG_USB_SERIAL_PL2303=y
CONFIG_NOP_USB_XCEIV=y
CONFIG_USB_ULPI=y
CONFIG_MMC=y
CONFIG_MMC_SDHCI=y
CONFIG_MMC_SDHCI_PLTFM=y
CONFIG_MMC_SDHCI_DOVE=y
CONFIG_MMC_SDHCI_PXAV3=y
CONFIG_MMC_MVSDIO=y
CONFIG_NEW_LEDS=y
CONFIG_LEDS_CLASS=y
CONFIG_LEDS_GPIO=y
CONFIG_LEDS_TRIGGER_TIMER=y
CONFIG_LEDS_TRIGGER_HEARTBEAT=y
CONFIG_RTC_CLASS=y
CONFIG_RTC_DRV_DS1307=y
CONFIG_RTC_DRV_PCF8563=y
CONFIG_RTC_DRV_S35390A=y
CONFIG_RTC_DRV_MV=y
CONFIG_RTC_DRV_ARMADA38X=y
CONFIG_DMADEVICES=y
CONFIG_MV_XOR=y
# CONFIG_IOMMU_SUPPORT is not set
CONFIG_MEMORY=y
CONFIG_PHY_MVEBU_A38X_COMPHY=y
CONFIG_EXT4_FS=y
CONFIG_ISO9660_FS=y
CONFIG_JOLIET=y
CONFIG_UDF_FS=m
CONFIG_MSDOS_FS=y
CONFIG_VFAT_FS=y
CONFIG_TMPFS=y
CONFIG_UBIFS_FS=y
CONFIG_NFS_FS=y
CONFIG_ROOT_NFS=y
CONFIG_NLS_CODEPAGE_437=y
CONFIG_NLS_CODEPAGE_850=y
CONFIG_NLS_ISO8859_1=y
CONFIG_NLS_ISO8859_2=y
CONFIG_NLS_UTF8=y
CONFIG_CRYPTO_DEV_MARVELL_CESA=y
CONFIG_PRINTK_TIME=y
# CONFIG_DEBUG_BUGVERBOSE is not set
CONFIG_DEBUG_INFO=y
CONFIG_MAGIC_SYSRQ=y
CONFIG_PANIC_ON_OOPS=y
CONFIG_PANIC_TIMEOUT=30
# CONFIG_SCHED_DEBUG is not set
CONFIG_DEBUG_USER=y
```
