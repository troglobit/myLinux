## configs/zero_defconfig
```kconfig
BR2_arm=y
BR2_cortex_a7=y
BR2_ARM_FPU_VFPV4=y
BR2_DL_DIR="$(BR2_EXTERNAL_MYLINUX_PATH)/dl"
BR2_CCACHE=y
BR2_CCACHE_DIR="$(BR2_EXTERNAL_MYLINUX_PATH)/.ccache"
BR2_GLOBAL_PATCH_DIR="board/orangepi/orangepi-zero/patches $(BR2_EXTERNAL_MYLINUX_PATH)/patches"
BR2_TOOLCHAIN_EXTERNAL=y
BR2_TOOLCHAIN_EXTERNAL_BOOTLIN=y
BR2_TARGET_GENERIC_HOSTNAME="anarchy"
BR2_TARGET_GENERIC_ISSUE="myLinux - Troglobit Software Inc."
BR2_INIT_FINIT=y
BR2_ROOTFS_DEVICE_CREATION_DYNAMIC_MDEV=y
BR2_ROOTFS_DEVICE_TABLE="system/device_table.txt $(BR2_EXTERNAL_MYLINUX_PATH)/board/common/xattrs"
BR2_TARGET_GENERIC_ROOT_PASSWD="secret"
BR2_SYSTEM_DHCP="eth0"
BR2_ROOTFS_USERS_TABLES="$(BR2_EXTERNAL_MYLINUX_PATH)/board/common/users_table.txt"
BR2_ROOTFS_OVERLAY="$(BR2_EXTERNAL_MYLINUX_PATH)/board/common/rootfs $(BR2_EXTERNAL_MYLINUX_PATH)/board/zero/rootfs"
BR2_ROOTFS_POST_BUILD_SCRIPT="board/orangepi/common/post-build.sh $(BR2_EXTERNAL_MYLINUX_PATH)/board/common/post-build.sh"
BR2_ROOTFS_POST_IMAGE_SCRIPT="support/scripts/genimage.sh $(BR2_EXTERNAL_MYLINUX_PATH)/board/common/post-image.sh"
BR2_ROOTFS_POST_SCRIPT_ARGS="-c $(BINARIES_DIR)/genimage.cfg"
BR2_LINUX_KERNEL=y
BR2_LINUX_KERNEL_CUSTOM_VERSION=y
BR2_LINUX_KERNEL_CUSTOM_VERSION_VALUE="5.15.16"
BR2_LINUX_KERNEL_DEFCONFIG="sunxi"
BR2_LINUX_KERNEL_CONFIG_FRAGMENT_FILES="board/orangepi/orangepi-zero/linux-extras.fragment"
BR2_LINUX_KERNEL_DTS_SUPPORT=y
BR2_LINUX_KERNEL_INTREE_DTS_NAME="sun8i-h2-plus-orangepi-zero"
BR2_LINUX_KERNEL_INSTALL_TARGET=y
BR2_LINUX_KERNEL_NEEDS_HOST_OPENSSL=y
BR2_PACKAGE_BUSYBOX_CONFIG="$(BR2_EXTERNAL_MYLINUX_PATH)/board/common/busybox_defconfig"
BR2_PACKAGE_BUSYBOX_SHOW_OTHERS=y
BR2_PACKAGE_E2FSPROGS=y
BR2_PACKAGE_MTD=y
BR2_PACKAGE_ARMBIAN_FIRMWARE=y
BR2_PACKAGE_ARMBIAN_FIRMWARE_XR819=y
BR2_PACKAGE_XR819_XRADIO=y
BR2_PACKAGE_DNSMASQ=y
BR2_PACKAGE_DROPBEAR=y
BR2_PACKAGE_DROPBEAR_DISABLE_REVERSEDNS=y
# BR2_PACKAGE_DROPBEAR_SMALL is not set
BR2_PACKAGE_DROPBEAR_WTMP=y
BR2_PACKAGE_DROPBEAR_LASTLOG=y
BR2_PACKAGE_DROPBEAR_LEGACY_CRYPTO=y
BR2_PACKAGE_ETHTOOL=y
BR2_PACKAGE_INADYN=y
BR2_PACKAGE_IPERF=y
BR2_PACKAGE_IPROUTE2=y
BR2_PACKAGE_IW=y
BR2_PACKAGE_MINI_SNMPD=y
BR2_PACKAGE_MROUTED=y
BR2_PACKAGE_NETCALC=y
BR2_PACKAGE_PIMD=y
BR2_PACKAGE_REDIR=y
BR2_PACKAGE_SMCROUTE=y
BR2_PACKAGE_SSDP_RESPONDER=y
BR2_PACKAGE_TCPDUMP=y
BR2_PACKAGE_UREDIR=y
BR2_PACKAGE_WIRELESS_REGDB=y
BR2_PACKAGE_WIRELESS_TOOLS=y
BR2_PACKAGE_WIRELESS_TOOLS_LIB=y
BR2_PACKAGE_WPA_SUPPLICANT=y
BR2_PACKAGE_WPA_SUPPLICANT_AUTOSCAN=y
BR2_PACKAGE_WPA_SUPPLICANT_EAP=y
BR2_PACKAGE_WPA_SUPPLICANT_DEBUG_SYSLOG=y
BR2_PACKAGE_WPA_SUPPLICANT_CLI=y
BR2_PACKAGE_WPA_SUPPLICANT_WPA_CLIENT_SO=y
BR2_PACKAGE_WPA_SUPPLICANT_PASSPHRASE=y
BR2_PACKAGE_PWGEN
BR2_PACKAGE_SYSKLOGD=y
BR2_PACKAGE_SYSKLOGD_LOGGER=y
BR2_PACKAGE_WATCHDOGD=y
BR2_PACKAGE_MG=y
BR2_TARGET_ROOTFS_EXT2=y
BR2_TARGET_ROOTFS_EXT2_4=y
BR2_TARGET_ROOTFS_EXT2_SIZE="384M"
# BR2_TARGET_ROOTFS_TAR is not set
BR2_TARGET_UBOOT=y
BR2_TARGET_UBOOT_BUILD_SYSTEM_KCONFIG=y
BR2_TARGET_UBOOT_CUSTOM_VERSION=y
BR2_TARGET_UBOOT_CUSTOM_VERSION_VALUE="2022.01"
BR2_TARGET_UBOOT_BOARD_DEFCONFIG="orangepi_zero"
BR2_TARGET_UBOOT_NEEDS_DTC=y
BR2_TARGET_UBOOT_NEEDS_PYLIBFDT=y
BR2_TARGET_UBOOT_FORMAT_CUSTOM=y
BR2_TARGET_UBOOT_FORMAT_CUSTOM_NAME="u-boot-sunxi-with-spl.bin"
BR2_TARGET_UBOOT_SPL=y
BR2_TARGET_UBOOT_SPL_NAME="u-boot-sunxi-with-spl.bin"
BR2_PACKAGE_HOST_GENIMAGE=y
BR2_PACKAGE_FINIT_PLUGIN_HOTPLUG=y
BR2_PACKAGE_FINIT_PLUGIN_MODULES_LOAD=y
BR2_PACKAGE_FINIT_PLUGIN_MODPROBE=y
BR2_PACKAGE_FINIT_PLUGIN_RTC=y
BR2_PACKAGE_FINIT_PLUGIN_TTY=y
BR2_PACKAGE_FINIT_PLUGIN_URANDOM=y
BR2_PACKAGE_MCJOIN=y
BR2_PACKAGE_MDNSD=y
BR2_PACKAGE_MDNSD_FTP_SERVICE=y
BR2_PACKAGE_MDNSD_HTTP_SERVICE=y
BR2_PACKAGE_NEMESIS=y
BR2_PACKAGE_SNTPD=y
BR2_PACKAGE_TETRIS=y
BR2_PACKAGE_UFTPD=y
```

## kernel/Kconfig
```kconfig
menu "Kernel"

choice
	prompt "Build Mode"
	default LINUX_BUILD_IMAGE

config LINUX_BUILD_HEADERS
	bool "Headers"
	help
	  Only extract the headers from the selected
	  version. Typically used to match ABI of the kernel on which
	  your containers are going to run.

config LINUX_BUILD_IMAGE
	bool "Image"
	help
	  Build a full Linux kernel image. This can be used to create
	  a bootable image that can run on hardware, in an emulator
	  (QEMU), or as an application (User Mode Linux).
endchoice

config LINUX_IMAGE
       string "Image Type"
       depends on LINUX_BUILD_IMAGE
       default "zImage"  if ARM
       default "Image"   if ARM64
       default "zImage"  if PPC
       default "bzImage" if X86
       help
         Use this type of kernel image format. If unsure, you probably
         want the default.

config LINUX_VERSION
       string "Linux version"
       help
	 Linux kernel version, downloaded from kernel.org, it is
       	 assumed to be a kernel >= 4.0

config LINUX_TESTING
       bool "Enable Linux testing (-rcN) versions"
       default n
       help
         Enable building testing kernels.

config LINUX_RC
       string "Linux -rcN version"
       depends on LINUX_TESTING
       help
	 Give on the form: -rcN, e.g. -rc2

config LINUX_CMDLINE
       string "Kernel command line"
       default "root=/dev/ram console=ttyAMA0,115200 quiet"
       help
         The command line to pass to the kernel at boot.  Here you can control
	 which init process to start as PID 1, e.g. init=/bin/sh to escape the
	 boot process entirely.  Or other flags, like --debug to debug Finit.

endmenu
```

## legacy/packages/Kconfig
```kconfig
menu "Networking packages"

config MERECAT
       bool "merecat - Simple throttling web server"
       help
         Merecat httpd is a simplified clone of thttpd by Jef Poskanzer,
         later picked up by Anthony G. Basile as sthttpd.  Merecat is
         maintained by Joachim Nilsson.
         
	 https://github.com/troglobit/merecat/

config NEMESIS
       bool "nemesis - packet crafting & injection"
       help
         The Nemesis Project is designed to be a command line based,
         portable human IP stack for UNIX-like and Windows systems. The
         suite is broken down by protocol, and should allow for useful
         scripting of injected packets from simple shell scripts.
	 
	 Nemesis is built on top of libnet.
	 
	 https://github.com/troglobit/nemesis/

config MCJOIN
       bool "mcjoin - Tiny multicast testing tool"
       help
         mcjoin is a very simple and easy-to-use tool to test IPv4
         multicast. Simply start a multicast generator (server) on one
         end and one or more data sinks (clients).
	 
	 By default group 225.1.2.3 and the UDP port 1234 is used, you
	 may want to try MCAST_TEST_NET from RFC5771, 233.252.0.0/24, or
	 the omping(8) test group 232.43.211.234 and UDP port 4321.  At
	 the moment max 250 groups can be joined.
	 
	 https://github.com/troglobit/mcjoin/

config UFTPD
       bool "uftpd - TFTP/FTP Daemon That Just Works"
       help
	 Troglobit uftpd, quick TFTP and fuzzy-less FTP daemon.
	 
	 https://troglobit.com/uftpd.html
endmenu

menu "System packages"

config BUSYBOX
       bool "BusyBox - Your basic embedded swiss army chainsaw"
       help
         BusyBox combines tiny versions of many common UNIX utilities
         into a single small executable. It provides replacements for
         most of the utilities you usually find in GNU fileutils,
         shellutils, etc. The utilities in BusyBox generally have fewer
         options than their full-featured GNU cousins; however, the
         options that are included provide the expected functionality
         and behave very much like their GNU counterparts. BusyBox
         provides a fairly complete environment for any small or
         embedded system.
	 
	 BusyBox has been written with size-optimization and limited
	 resources in mind. It is also extremely modular so you can
	 easily include or exclude commands (or features) at compile
	 time. This makes it easy to customize your embedded systems. To
	 create a working system, just add some device nodes in /dev, a
	 few configuration files in /etc, and a Linux kernel.
	 
	 Use `make packages/busybox-menuconfig` and `-saveconfig` to
	 modify and save your BusyBox configuration.
	 
	 https://busybox.net/

config CX
       bool "cx - A simple wrapper for Linux Containers (lxc)"
       depends on LXC
       help
         Very simple wrapper around lxc, handles importing images, creating
	 basic lxc config files, starting/stopping and attching to container.
         
	 https://github.com/troglobit/cx

config FINIT
       bool "finit - Fast SysV init Replacement with Process Supervision"
       help
         The original Asus EeePC fastinit clone, on steroids.  With process
	 supervision, plugin support, and more!
	 
	 https://troglobit.com/finit.html

config FINIT_BOOT_ANIMATION
	bool "ASCII boot animation instead of traditional Finit progress"
	depends on FINIT
	help
	  Selecting this enables an ASCII art boot animation instead of
	  the traditional Finit progress.

config LXC
       bool "lxc - Linux Containers (LXC)"
       help
         Linux Containers (LXC), provides the ability to group and
	 isolate of a set of processes in a jail by virtualizing and
	 accounting the kernel resources.  It is similar to the more
	 famous Docker and OpenVZ.
         
	 https://linuxcontainers.org/
endmenu
```

## lib/Kconfig
```kconfig
menu "Libraries"

config CONFUSE
       bool "libConfuse"
       help
	 libConfuse is a configuration file parser library, licensed
	 under the terms of the ISC license, and written in C.
	 
	 It supports sections and, lists of, values: strings, integers,
	 floats, booleans.  Other features include single/double-quoted
	 strings, environment variable expansion, functions and nested
	 include statements.  Making it very easy to add configuration
	 file capability to a program using a simple API.
	 
	 https://github.com/martinh/libconfuse

config LIBITE
       bool "libite (LITE)"
       help
	 This is a lightweight helper library with all misc. functions
	 missing on a Linux system, c.f. regular UNIX (OpenBSD).  With
	 some sugar on top.  Your basic frog DNA.

config LIBUEV
       bool "libuEv"
       help
	 uEv is a small Linux-only event loop library used by, e.g.,
	 Finit and uftpd.

config LIPIFY
       bool "lipify - C library for http://ipify.org"
       help
	 Very small C library for http://ipify.org, the open "what's my IP" API.
	 
	 https://github.com/troglobit/lipify/

config LIBMNL
       bool "libmnl, a minimalistic user-space Netlink library"
       help
	 libmnl is a minimalistic user-space library oriented to Netlink
	 developers. There are a lot of common tasks in parsing, validating,
	 constructing of both the Netlink header and TLVs that are repetitive
	 and easy to get wrong. This library aims to provide simple helpers
	 that allows you to re-use code and to avoid re-inventing the wheel. 
	 
	 https://www.netfilter.org/projects/libmnl/

config NCURSES
       bool "Ncurses"
       help
	 Programming library for text-based user interfaces. Provides
	 a replacement for the old BSD curses library, but also compat
	 libraries for termcap.
	 
	 http://invisible-island.net/ncurses/ncurses.html

config ZLIB
       bool "Zlib"
       help
	 Zlib is used by some apps
endmenu
```

## package/Config.in
```kconfig
source "$BR2_EXTERNAL_MYLINUX_PATH/package/cligen/Config.in"
source "$BR2_EXTERNAL_MYLINUX_PATH/package/clixon/Config.in"
source "$BR2_EXTERNAL_MYLINUX_PATH/package/finit/Config.in"
source "$BR2_EXTERNAL_MYLINUX_PATH/package/finit-plugins/Config.in"
source "$BR2_EXTERNAL_MYLINUX_PATH/package/skeleton-init-finit/Config.in"
source "$BR2_EXTERNAL_MYLINUX_PATH/package/mcjoin/Config.in"
source "$BR2_EXTERNAL_MYLINUX_PATH/package/mdnsd/Config.in"
source "$BR2_EXTERNAL_MYLINUX_PATH/package/mech/Config.in"
source "$BR2_EXTERNAL_MYLINUX_PATH/package/nemesis/Config.in"
source "$BR2_EXTERNAL_MYLINUX_PATH/package/sntpd/Config.in"
source "$BR2_EXTERNAL_MYLINUX_PATH/package/tetris/Config.in"
source "$BR2_EXTERNAL_MYLINUX_PATH/package/uftpd/Config.in"
source "$BR2_EXTERNAL_MYLINUX_PATH/package/webif/Config.in"
```

## package/finit-plugins/Config.in
```kconfig
if BR2_PACKAGE_FINIT

config BR2_PACKAGE_FINIT_PLUGINS
	bool "finit plugins"
	help
	  Repository of 3rd party plugins for Finit.

          https://github.com/troglobit/finit-plugins

if BR2_PACKAGE_FINIT_PLUGINS

config BR2_PACKAGE_FINIT_PLUGINS_CHRONY
	bool "chrony plugin"

config BR2_PACKAGE_FINIT_PLUGINS_QMI_PROXY
	bool "qmi-proxy plugin"

endif

endif
```

## package/finit/Config.in
```kconfig
config BR2_PACKAGE_FINIT
	bool "finit"
	depends on BR2_USE_MMU # fork()
	select BR2_PACKAGE_LIBITE
	select BR2_PACKAGE_LIBUEV
	select BR2_PACKAGE_SKELETON_INIT_FINIT # before BR2_INIT_FINIT support
	help
	  The original Asus EeePC fastinit clone, on steroids.  With process
	  supervision, plugin support, and more!

	  https://github.com/troglobit/finit

if BR2_PACKAGE_FINIT

config BR2_PACKAGE_FINIT_INITCTL_GROUP
	string "Group for /run/finit/socket"
	default "wheel"
	help
	  On systems with multiple administrators, set the group
	  to their shared UNIX group, usually "wheel", to allow
	  them to start/stop services and reboot the system.

config BR2_PACKAGE_FINIT_KEVENTD
	bool "finit-keventd"
	default n
	help
	  Build bundled finit-keventd, which monitors kernel events
	  for AC power status and generates sys/pwr/fail condition.
	  This is a new feature in Finit v4.1 and is still very much
	  in an experimental state.

	  For lxc/docker application builds you do not need this.

config BR2_PACKAGE_FINIT_WATCHDOG
	bool "finit-watchdogd"
	default n
	help
	  Build bundled finit-watchdogd, which provides a simplistic
	  watchdog daemon that runs in the background, kicking the
	  systemd default /dev/watchdog to prevent reboot.  This is
	  useful in very small systems where its grownup old cousin
	  watchdogd cannot be used.

	  For lxc/docker application builds you do not need this.

if BR2_PACKAGE_FINIT_WATCHDOG

config BR2_PACKAGE_FINIT_WATCHDOG_DEV
	string "watchdog device"
	default "/dev/watchdog"
	help
	  Device node to use for finit-watchdogd.  The default is
	  usually sufficient, but some systems have more than one.

endif

config BR2_PACKAGE_FINIT_PLUGIN_HOTPLUG
	bool "hotplug plugin (mdev/udev)"
	help
	  By default, Finit builds and launches its hotplug plugin.
	  It is responsible for detecting and starting the mdev tool,
	  or udevd daemon.  The former exists in many BusyBox based
	  systems and is called for "cold plugging".  The latter has
	  many various incarnations and is mostly used for desktop
	  systems.

	  For lxc/docker application builds you do not need this.

config BR2_PACKAGE_FINIT_PLUGIN_MODULES_LOAD
	bool "Scan /etc/modules-load.d"
	help
	  Scans /etc/modules-load.d for modules to load.

	  For lxc/docker application builds you do not need this.

config BR2_PACKAGE_FINIT_PLUGIN_MODPROBE
	bool "Coldplug modules using modalias magic"
	help
	  Coldplug modules using modalias magic.  Everything is
	  handled automatically based on device trees and their
	  matching kernel modules.

	  For lxc/docker application builds you do not need this.

config BR2_PACKAGE_FINIT_PLUGIN_RTC
	bool "RTC plugin"
	help
	  By default, Finit builds and launches its RTC plugin.  It is
	  responsible for restoring the system clock from the RTC clock
	  at boot, and saving the system clock to RTC at reboot.

	  For lxc/docker application builds you do not need this.

config BR2_PACKAGE_FINIT_PLUGIN_TTY
	bool "TTY plugin"
	help
	  Automatically resart tty services that are plugged in.

	  For lxc/docker application builds you do not need this.

config BR2_PACKAGE_FINIT_PLUGIN_URANDOM
	bool "/dev/urandom plugin"
	help
	  By default, Finit builds and launches its urandom plugin.  It
	  is responsible for seeding /dev/urandom from a previously saved
	  seed at boot, and saving a seed at reboot.

	  For lxc/docker application builds you do not need this.

endif
```
